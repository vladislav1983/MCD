/******************************************************************************/
/* 
 *                 				PWM MODULE SUPPORT            
 *       
*/
/******************************************************************************/

/*----------------------------------------------------------------------------*/
/* Body Identification                                                        */
/*----------------------------------------------------------------------------*/
#ifdef PWM_C
    #error "!!! FileName ID. It should be Unique !!!"
#else
    #define PWM_C 
#endif
/*----------------------------------------------------------------------------*/
/* Included files to resolve specific definitions in this file                */
/*----------------------------------------------------------------------------*/
#include "includes.h"
#include "SVM.H"

/*----------------------------------------------------------------------------*/
/* Local constants                                                            */
/*----------------------------------------------------------------------------*/


/*----------------------------------------------------------------------------*/
/* Local macros                                                               */
/*----------------------------------------------------------------------------*/


/*----------------------------------------------------------------------------*/
/* Local types                                                                */
/*----------------------------------------------------------------------------*/


/*----------------------------------------------------------------------------*/
/* Local data                                                                 */
/*----------------------------------------------------------------------------*/


/*----------------------------------------------------------------------------*/
/* Constant local data                                                        */
/*----------------------------------------------------------------------------*/


/*----------------------------------------------------------------------------*/
/* Exported data to other modules                                             */
/*----------------------------------------------------------------------------*/


/*----------------------------------------------------------------------------*/
/* Exported data from other modules                                           */
/*----------------------------------------------------------------------------*/


/*----------------------------------------------------------------------------*/
/* Constant exported data                                                     */
/*----------------------------------------------------------------------------*/


/*----------------------------------------------------------------------------*/
/* Local function prototypes                                                  */
/*----------------------------------------------------------------------------*/
void __attribute__((__interrupt__,no_auto_psv)) _PWMInterrupt(void);
void __attribute__((__interrupt__,no_auto_psv)) _FLTAInterrupt(void);
/******************************************************************************/
/*                                                                            */
/*                   I N T E R F A C E   F U N C T I O N S                    */
/*                                                                            */
/******************************************************************************/
/******************************************************************************/
/*
* Purpose: Init PWM Module 
* Input: none 
* Output: none 
*/
/******************************************************************************/
void IF_PWM_Init(void)
{
	
	//	PTCON: PWM Time Base Control Register
	// |--------------------------------------------------------------------------------------------
    // | PTEN   —   PTSIDL  —   —   —   —   —	PTOPS<3:0>		PTCKPS<1:0> 	PTMOD<1:0>
    // |--------------------------------------------------------------------------------------------
    // |   x    x           x   x   x   x   x
    // |--------------------------------------------------------------------------------------------
	
	PTCON = 0x0000;
	
	PTCONbits.PTEN  = 1;	// 1 = PWM time base is ON
	PTCONbits.PTMOD = 0b11;	// 10 = PWM time base operates in a continuous up/down counting mode
	
		
	//	PTMR: PWM Time Base Register
	// |--------------------------------------------------------------------------------------------
    // | PTDIR			PTMR<14:8> 			PTMR <7:0>
    // |--------------------------------------------------------------------------------------------
    // |
    // |--------------------------------------------------------------------------------------------

	//	PTPER: PWM Time Base Period Register
	// |--------------------------------------------------------------------------------------------
    // |   — 			PTPER <14:8>		PTPER <7:0>
    // |--------------------------------------------------------------------------------------------
    // | 
    // |--------------------------------------------------------------------------------------------
	
	PTPER = (U16)(((U32)PWM_PERIOD_ns / cTcy_ns) / 2);
	
	//	SEVTCMP: Special Event Compare Register
	// |--------------------------------------------------------------------------------------------
    // |   SEVTDIR 		SEVTCMP <14:8>		SEVTCMP <7:0>
    // |--------------------------------------------------------------------------------------------
    // | 
    // |--------------------------------------------------------------------------------------------
    
    SEVTCMP = 0x0000;
    SEVTCMPbits.SEVTDIR = 1;		// 1 = A special event trigger will occur when the PWM time base is counting downwards.
	SEVTCMPbits.SEVTCMP = 2;        // Cannot be 0 -> turns off trigger (Missing from doc)       

	//	PWMCON1: PWM Control Register 1
	// |--------------------------------------------------------------------------------------------
    // |   — — — — 	PMOD4 PMOD3 PMOD2 PMOD1 PEN4H PEN3H PEN2H PEN1H PEN4L PEN3L PEN2L PEN1L
    // |--------------------------------------------------------------------------------------------
    // |   x x x x                            0     1     1     1     0     1     1      1
    // |--------------------------------------------------------------------------------------------
	/**********************************************************************************************
		(bit 11-8)
					0 = PWM I/O pin pair is in the complementary output mode
	 	(bit 7-4)
	 				0 = PWMxH pin disabled. I/O pin becomes general purpose I/O	
	 				1 = PWM3H pin is enabled for PWM output
	 				1 = PWM2H pin is enabled for PWM output
	 				1 = PWM1H pin is enabled for PWM output
		(bit 3-0) 
					0 = PWMxL pin disabled. I/O pin becomes general purpose I/O	
					1 = PWM3L pin is enabled for PWM output
					1 = PWM2L pin is enabled for PWM output
					1 = PWM1L pin is enabled for PWM output
	**********************************************************************************************/
	
	PWMCON1 = 0b0000000001110111;
	

	//	PWMCON2: PWM Control Register 2
	// |--------------------------------------------------------------------------------------------
    // |   — — — — SEVOPS<3:0> — — — — — 	IUE 	OSYNC 	UDIS
    // |--------------------------------------------------------------------------------------------
    // |   x x x x             x x x x x   
    // |--------------------------------------------------------------------------------------------
	
	PWMCON2 = 0x0000;

	//	DTCON1: Dead Time Control Register 1
	// |--------------------------------------------------------------------------------------------
    // |   DTBPS<1:0>			DTB<5:0> 			DTAPS<1:0> 				DTA<5:0>
    // |--------------------------------------------------------------------------------------------
    // | 	  11                 100000                 11                   100000
    // |--------------------------------------------------------------------------------------------
	
	DTCON1 = 0x0000;
	//DTCON1bits.DTBPS = 0b11;	//11 = Clock period for Dead Time Unit B is 8 TCY
	DTCON1bits.DTAPS = 0b10;	//01 = Clock period for Dead Time Unit B is 2 TCY
	
	DTCON1bits.DTA = (PWM_DEAD_TIME_ns / (PWM_DEAD_TIME_PRESCALER * cTcy_ns));
	//DTCON1bits.DTB = (PWM_DEAD_TIME_ns / (PWM_DEAD_TIME_PRESCALER * cTcy_ns));
	
	//	DTCON2: Dead Time Control Register 2
	// |--------------------------------------------------------------------------------------------
    // |   — — — — — — — — DTS4A	DTS4I	DTS3A	DTS3I	DTS2A	DTS2I	DTS1A	DTS1I
    // |--------------------------------------------------------------------------------------------
    // |   x x x x x x x x   0        0       0       0       0       0       0       0    
    // |--------------------------------------------------------------------------------------------
	
	DTCON2 = 0x0000;


	//	FLTACON: Fault A Control Register
	// |--------------------------------------------------------------------------------------------
    // | FAOV4H FAOV4L FAOV3H FAOV3L FAOV2H FAOV2L FAOV1H FAOV1L FLTAM — — — FAEN4 FAEN3 FAEN2 FAEN1
    // |--------------------------------------------------------------------------------------------
    // |    0      0      0      0      0      0      0      0      0  x x x   1     1     1     1
    // |--------------------------------------------------------------------------------------------
	/**********************************************************************************************
		bit 3 - 1 = PWM4H/PWM4L pin pair is controlled by Fault Input A
		bit 2 - 1 = PWM3H/PWM3L pin pair is controlled by Fault Input A
		bit 1 - 1 = PWM2H/PWM2L pin pair is controlled by Fault Input A
		bit 0 - 1 = PWM1H/PWM1L pin pair is controlled by Fault Input A	
	**********************************************************************************************/
	
	FLTACON = 0b0000000000001111;


	//	FLTBCON: Fault B Control Register
	// |--------------------------------------------------------------------------------------------
    // | FBOV4H FBOV4L FBOV3H FBOV3L FBOV2H FBOV2L FBOV1H FBOV1L FLTBM — — — FBEN4 FBEN3 FBEN2 FBEN1
    // |--------------------------------------------------------------------------------------------
    // |    0      0      0      0      0      0      0     0     0    x x x   0     0     0     0
    // |--------------------------------------------------------------------------------------------
	
	FLTBCON = 0x0000;

	PDC1 = PTPER;
	PDC2 = PTPER;
	PDC3 = PTPER;
	PDC4 = 0x0000;
	
	/* PWM Interrupt Setup */
	_PWMIP = cISR_PRIORITY_PWM;	//Set Interrupt Priority
	_PWMIF = 0;					//Clear Interrupt flag
	_PWMIE = 1;					//Enable PWM Interrupt
	
	/* FLTA Interrupt Setup */
	_FLTAIP = cISR_PRIORITY_FLTA;
	_FLTAIF = 0;
	_FLTAIE = 1;


}
/******************************************************************************/
/*
* Purpose: PWM Output Test
* Input: none
* Output: none  
*/
/******************************************************************************/
void PWM_Output_Test(void)
{











}

/******************************************************************************/
/******************************************************************************/
/*                                                                            */
/*                       L O C A L   F U N C T I O N S                        */
/*                                                                            */
/******************************************************************************/

/******************************************************************************/
/*
* Purpose: PWM Interrupt Handler. Used as Dispatcher to drive task1 and task2.
* Input: none
* Output: none  
*/
/******************************************************************************/
void __attribute__((__interrupt__,no_auto_psv)) _PWMInterrupt(void)
{
	struct sTaskCounterStruct *tc;
	
	tc = _get_task_count();
	
	if( PWM_MODULE_COUNT_UP )
	{
		if(_drive_enabled()) Load_Ton();			// Load T_ON PDCx Registers	
		if( _is_task1_execute() ) _set_task1_runtime_fault(1);
		else _INT1IF = 1; 	// Run TASK1
	}
	else
	{
		ADC_Process();		// Run ADC Measurement
		if(_drive_enabled()) Load_Toff();		// Load T_OFF PDCx Registers	
	}
	
	if( --(tc)->T2_count <= 0 )
	{
		if( _is_task2_execute() ) _set_task2_runtime_fault(1);
		else _INT2IF = 1; // Run TASK2
		
		(tc)->T2_count = T2_PERIOD;
	}

	_PWMIF = 0;					//Clear Interrupt flag
}

/******************************************************************************/
/*
* Purpose: PWM Fault Interrupt Handler.
* Input: none
* Output: none  
* Notes: In Interrupt Set Power Unit Fault Flag and Drive Disable.
*/
/******************************************************************************/
void __attribute__((__interrupt__,no_auto_psv)) _FLTAInterrupt(void)
{
	DRIVE_DISABLE();			// Drive Disable
				
	_set_power_unit_fault(1); 	// Set Power Unit Fault Flag
	
	_FLTAIF = 0;				// Clear Interrupt
}
